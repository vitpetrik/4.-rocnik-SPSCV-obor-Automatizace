#include <time.h>
#include <conio.h>
#include <stdio.h>
#include <dos.h>
#include <stdlib.h>
#include <iostream.h>

#define P1 0x300
#define P2 0x301
#define P3 0x300
#define P4 0x301

#define TAB 9
#define BACKSPACE 8
#define ESC 27

#define NUMERIC_DISP 0
#define ALPHANUMERIC_DISP 1

char PORT[4];

typedef struct
{
	char port;
	char bit;
} pin;

//vrati pocet milisekund od startu programu
unsigned long millis()
{
	return (clock() * 1000) / CLOCKS_PER_SEC;
}

//trida citace, je vyuzit pro generovani taktu
class Counter
{
private:
	int count, resolution, prescaler, prescalerCount;

public:
	//nastaveni citace
	//resolution, prescaler
	void setup(int res, int pre)
	{
		resolution = res;
		prescaler = pre;
		count = 0;
		prescalerCount = 0;
	}

	//vrati hodnotu citace
	int getCount()
	{
		return count;
	}

	void reset()
	{
		count = 0;
		prescalerCount = 0;
	}

	//cyklus citace
	void run()
	{
		if (prescalerCount >= prescaler)
		{
			count++;
			prescalerCount = 0;
		}
		if (count + 1 > resolution)
		{
			count = 0;
		}
		prescalerCount++;
	}
};

class SerialTransmit
{
private:
	pin Tx, Clk;
	Counter square;
	char *buffer;
	int bufferSize;
	int index;
	char completed;

public:
	SerialTransmit()
	{
		square.setup(4, 0);
		index = 0;
		bufferSize = 0;
		completed = 1;
	}

	void setup(pin Tx_pin, pin Clk_pin)
	{
		Tx = Tx_pin;
		Clk = Clk_pin;
	}

	char write(char *buff, int size)
	{
		if (!transmitCompleted())
			return 0;
		buffer = buff;
		bufferSize = size;
		index = 0;
		completed = 0;
		return 1;
	}

	char transmitCompleted()
	{
		return completed;
	}

	void run()
	{
		if (!completed)
		{
			PORT[Clk.port] ^= (-(square.getCount() / 2) ^ PORT[Clk.port]) & (1UL << Clk.bit);
			if (square.getCount() == 1)
			{
				PORT[Tx.port] ^= (-(!!(buffer[index] & (1 << 0))) ^ PORT[Tx.port]) & (1UL << Tx.bit);
				index++;
				bufferSize--;
			}
			square.run();
			if (!bufferSize && (square.getCount() == 0))
			{
				completed = 1;
				square.reset();
			}
		}
		else
		{
			PORT[Clk.port] ^= (-0 ^ PORT[Clk.port]) & (1UL << Clk.bit);
			PORT[Tx.port] ^= (-0 ^ PORT[Tx.port]) & (1UL << Tx.bit);
		}
	}
};

class M5451
{
private:
	static const unsigned char SevenSegmentASCII[96];
	static const unsigned int FourteenSegmentASCII[96];

	SerialTransmit serial;
	char *string;

	char displayType;
	char newString;
	char anodeSwitch;

	char outputBuffer[36];

	void addToBuffer7seg(char byte, char startBit, char numOfBits)
	{
		for (char i = 0; i < numOfBits; i++)
		{
			outputBuffer[startBit + i] = !!(byte & (1 << i));
		}
	}

	void addToBuffer14seg(int byte, char startBit, char numOfBits)
	{
		static char bitPosition[15] = {0, 1, 2, 3, 4, 5, 6, 7, 8, 9, 10, 11, 12, 13, 14};
		for (char i = 0; i < numOfBits; i++)
		{
			outputBuffer[startBit + bitPosition[i]] = !!(byte & (1 << i));
		}
	}

public:
	M5451(pin Tx_pin, pin Clk_pin, char disp, char *s)
	{
		onChange();
		serial.setup(Tx_pin, Clk_pin);
		displayType = disp;
		string = s;
		anodeSwitch = 0;
	}

	//nastavení pointeru na stringu
	void setString(char *s)
	{
		onChange();
		string = s;
	}

	void setDisplayType(char disp)
	{
		onChange();
		displayType = disp;
	}

	char getDisplayType()
	{
		return displayType;
	}

	void onChange()
	{
		newString = 1;
		for (char i = 0; i < 36; i++)
		{
			outputBuffer[i] = 0;
		}
	}

	char transmitCompleted()
	{
		return serial.transmitCompleted();
	}

	void run()
	{
		switch (displayType)
		{
		case NUMERIC_DISP:
			if (newString && transmitCompleted())
			{
				char stringElement = 0;
				outputBuffer[0] = 1;
				for (char i = 0; i < 5; i++)
				{
					stringElement = string[i] >= ' ' ? SevenSegmentASCII[string[i] - ' '] : 0;
					addToBuffer7seg(stringElement, (i * 7) + 1, 7);
				}
				serial.write(outputBuffer, sizeof(outputBuffer) / sizeof(*outputBuffer));
				newString = 0;
			}
			break;
		case ALPHANUMERIC_DISP:
			if (transmitCompleted())
			{
				int stringElement = 0;
				outputBuffer[0] = 1;
				char help = 0;
				if (!anodeSwitch)
				{
					stringElement = string[0] >= ' ' ? FourteenSegmentASCII[string[0] - ' '] : 0;
					addToBuffer14seg(stringElement, 1, 15);

					stringElement = string[2] >= ' ' ? FourteenSegmentASCII[string[2] - ' '] : 0;
					addToBuffer14seg(stringElement, (1 * 15) + 1, 15);
				}
				else
				{
					stringElement = string[1] >= ' ' ? FourteenSegmentASCII[string[1] - ' '] : 0;
					addToBuffer14seg(stringElement, (1 * 15) + 1, 15);

					stringElement = string[3] >= ' ' ? FourteenSegmentASCII[string[3] - ' '] : 0;
					addToBuffer14seg(stringElement, (1 * 15) + 1, 15);
				}
				outputBuffer[31] = !anodeSwitch;
				outputBuffer[32] = anodeSwitch;

				serial.write(outputBuffer, sizeof(outputBuffer) / sizeof(*outputBuffer));
				anodeSwitch = !anodeSwitch;
			}
			break;
		}
		serial.run();
	}
};

const unsigned char M5451::SevenSegmentASCII[96] = {
	0x00, /* (space) */
	0x86, /* ! */
	0x22, /* " */
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	0x00, /* (del) */
};
const unsigned int M5451::FourteenSegmentASCII[96] = {
	0x0000, /* (space) */
	0x4006, /* ! */
	0x0202, /* " */
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	0x0000, /* (del) */
};

int main(void)
{
	//inicializace promennych a tridy displeje
	system("cls");
	char inputStr[] = "12345";
	cout << "Zobrazeny text muzete zmenit pomoci klavesy backspace\n\r";
	cout << "Typ displeje pomoci klavesy TAB\n\r";
	pin Tx = {0, 0};
	pin Clk = {0, 1};
	M5451 display(Tx, Clk, NUMERIC_DISP, inputStr);
	char exitLoop = 0;
	while (1)
	{
		//vezme stisknutou klavesu (pokud nejake je)
		if (kbhit())
		{
			switch (getch())
			{
			case BACKSPACE:
				cout << "\n\rZadejte text k zobrazeni: ";
				gets(inputStr);
				display.onChange();
				break;
			case TAB:
				display.setDisplayType(!display.getDisplayType());
				break;
			case ESC:
				exitLoop = 1;
				break;
			}
		}

		display.run();

		outportb(P1, PORT[0]);

		//pokud zmackneme ESC a je dokonceno vysilani opustime smycku
		if (exitLoop && display.transmitCompleted())
		{
			break;
		}
	}
	//konec programu a navrat do Borlanda
	while (!kbhit())
		;
	return 0;
}